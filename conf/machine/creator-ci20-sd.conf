## conf/machine/creator-ci20-sd.conf
```bitbake
#@TYPE: Machine
#@NAME: CI20
#@SOC: Ingenic JZ4780 MIPS
#@DESCRIPTION: MIPS Creator CI20
#@MAINTAINER: Leon Anavi <leon@anavi.org>

require creator-ci20.inc
UBOOT_MACHINE = "ci20_mmc"
```

## conf/machine/creator-ci20.inc
```bitbake
#@TYPE: Machine
#@NAME: CI20
#@SOC: Ingenic JZ4780 MIPS
#@DESCRIPTION: MIPS Creator CI20
#@MAINTAINER: Leon Anavi <leon@anavi.org>

require conf/machine/include/tune-mips32r2.inc
IMAGE_CLASSES += "image_types_ci20"

DEFAULTTUNE = "mips32r2el"
MACHINE_FEATURES = "serial"
SERIAL_CONSOLE="115200 ttyS4"

EXTRA_IMAGEDEPENDS += "u-boot-ci20"

KERNEL_IMAGETYPE = "uImage"

PREFERRED_PROVIDER_virtual/kernel ?= "linux-creator-ci20"
PREFERRED_VERSION_linux-creator-ci20 ?= "3.18%"

#PREFERRED_PROVIDER_virtual/kernel ?= "linux-xburst"

PREFERRED_PROVIDER_u-boot = "u-boot-ci20"
PREFERRED_PROVIDER_u-boot-fw-utils = "u-boot-fw-utils-ci20"

#PREFERRED_VERSION_u-boot-ci20 ?= "ci20-v2013.10%"

MACHINE_ESSENTIAL_EXTRA_RDEPENDS = "kernel kernel-modules"

SDCARD_ROOTFS_TYPE ?= "ext3"
SDCARD_ROOTFS ?= "${IMGDEPLOYDIR}/${IMAGE_NAME}${IMAGE_NAME_SUFFIX}.${SDCARD_ROOTFS_TYPE}"

IMAGE_FSTYPES ?= "tar.bz2 ext3 sdcard"

MACHINE_FEATURES += " wifi bluetooth"

# For mender to work we have to install the kernel & devicetree.
#IMAGE_INSTALL_append=" kernel kernel-devicetree"

# The mender post-install scripts can install u-boot to do an upgrade
IMAGE_INSTALL_append=" u-boot-ci20 "

# Machine configuration common to all MuuseLabs hardware releases.

# TODO(wdm) Review this. Why are they all needed? And why the double __ ?
PREFERRED_PROVIDER_wpa-supplicant-cli__${MACHINE}       = "wpa-supplicant"
PREFERRED_PROVIDER_wpa-supplicant-passphrase_${MACHINE} = "wpa-supplicant"
PREFERRED_PROVIDER_wpa-supplicant_${MACHINE}            = "wpa-supplicant"

MACHINE_FEATURES_remove = "touchscreen"

# TODO(wdm) Not for final production version ML_DEV_ONLY.
# add USB debugging and launch a console on the first USB port exposed
# This is a machine setting, not an image setting.
# Used by bitbake sysvinit-inittab to create /etc/inittab in the rootfs.
SERIAL_CONSOLES_append = "115200;ttyS4 115200;ttyGS0"
IMAGE_INSTALL_append = " ml-usb-debug"

# Generate /etc/build.
# TODO(wdm) Reproducible builds. Fix the recipes so that the layer hashes
#           fully define the build.
INHERIT_append = " image-buildinfo"
# Note(wdm) Don't include any non-reproducible variables (like DATETIME).
IMAGE_BUILDINFO_VARS = "DISTRO DISTRO_VERSION MACHINE"

# Try to turn off QEUMU support? qemu required to support GObject introspection data.
# TODO(wdm) Needed for gstreamer?
# See https://lists.yoctoproject.org/pipermail/yocto/2016-April/029579.html
MACHINE_FEATURES_BACKFILL_CONSIDERED = "qemu-usermode"
# Try to speed up the build a little?
DISTRO_FEATURES_BACKFILL_CONSIDERED = "gobject-introspection-data"

#disable Mender
BBMASK_append = " meta-mender/meta-mender-core/recipes-bsp/u-boot"
```

## conf/machine/phoenix.conf
```bitbake
#@TYPE: Machine
#@NAME: Phoenix (SD card)
#@SOC: Ingenic X1000 MIPS
#@DESCRIPTION: Ingenix Phoenix
#@MAINTAINER: Pieter Palmers <pieter@muuselabs.com>

require phoenix.inc
UBOOT_MACHINE = "halley2_uImage_sfc_nor"

# if we build an SD card image this might be needed
#MACHINE_ESSENTIAL_EXTRA_RDEPENDS = "kernel kernel-modules"
```

## conf/machine/phoenix.inc
```bitbake
#@TYPE: Machine
#@NAME: Phoenix
#@SOC: Ingenic X1000 MIPS
#@DESCRIPTION: Ingenic Phoenix board
#@MAINTAINER: Pieter Palmers <pieter@muuselabs.com>

require conf/machine/include/tune-mips32r2.inc

MACHINEOVERRIDES =. "x1000:"

IMAGE_CLASSES += "image_types_x1000"

DEFAULTTUNE = "mips32r2el"
MACHINE_FEATURES = "serial"
SERIAL_CONSOLE="115200 ttyS2"

EXTRA_IMAGEDEPENDS += "u-boot-x1000"

KERNEL_IMAGETYPE = "uImage"

#PREFERRED_PROVIDER_virtual/kernel ?= "linux-ingenic"
PREFERRED_PROVIDER_virtual/kernel ?= "linux-x1000"

#MACHINE_EXTRA_RRECOMMENDS = "ap6212a-fw"


PREFERRED_PROVIDER_u-boot = "u-boot-x1000"
PREFERRED_PROVIDER_u-boot-fw-utils = "u-boot-fw-utils-x1000"

# the SFC NOR on the phoenix has a 0x8000 erasesize
JFFS2_ERASEBLOCK = "0x8000"

SDCARD_ROOTFS_TYPE ?= "ext4"
SDCARD_ROOTFS ?= "${IMGDEPLOYDIR}/${IMAGE_NAME}${IMAGE_NAME_SUFFIX}.${SDCARD_ROOTFS_TYPE}"

IMAGE_FSTYPES ?= "jffs2 sdcard"

MACHINE_FEATURES += " wifi bluetooth"


# Machine configuration common to all MuuseLabs hardware releases.

# TODO(wdm) Review this. Why are they all needed? And why the double __ ?
PREFERRED_PROVIDER_wpa-supplicant-cli__${MACHINE}       = "wpa-supplicant"
PREFERRED_PROVIDER_wpa-supplicant-passphrase_${MACHINE} = "wpa-supplicant"
PREFERRED_PROVIDER_wpa-supplicant_${MACHINE}            = "wpa-supplicant"

MACHINE_FEATURES_remove = "touchscreen"

# TODO(wdm) Not for final production version ML_DEV_ONLY.
# add USB debugging and launch a console on the first USB port exposed
# This is a machine setting, not an image setting.
# Used by bitbake sysvinit-inittab to create /etc/inittab in the rootfs.
#SERIAL_CONSOLES_append = "115200;ttyS2 115200;ttyGS0"

# Generate /etc/build.
# TODO(wdm) Reproducible builds. Fix the recipes so that the layer hashes
#           fully define the build.
INHERIT_append = " image-buildinfo"
# Note(wdm) Don't include any non-reproducible variables (like DATETIME).
IMAGE_BUILDINFO_VARS = "DISTRO DISTRO_VERSION MACHINE"

# Try to turn off QEUMU support? qemu required to support GObject introspection data.
# TODO(wdm) Needed for gstreamer?
# See https://lists.yoctoproject.org/pipermail/yocto/2016-April/029579.html
MACHINE_FEATURES_BACKFILL_CONSIDERED = "qemu-usermode"
# Try to speed up the build a little?
DISTRO_FEATURES_BACKFILL_CONSIDERED = "gobject-introspection-data"

# if no device manager is used, this table will give the devices
IMAGE_DEVICE_TABLES = "conf/machine/device_table-phoenix.txt"

#disable Mender
BBMASK_append = " meta-mender/meta-mender-core/recipes-bsp/u-boot"

# For mender to work we have to install the kernel & devicetree.
#IMAGE_INSTALL_append=" kernel kernel-devicetree"

# The mender post-install scripts can install u-boot to do an upgrade
#IMAGE_INSTALL_append=" u-boot-x1000 "

KERNEL_CONSOLE="ttyS2"
```

## recipes-kernel/linux/linux-ingenic/phoenix/defconfig
```kconfig
CONFIG_MACH_XBURST=y
CONFIG_CPU_MIPS32_R2=y
CONFIG_FORCE_MAX_ZONEORDER=15
# CONFIG_COMPACTION is not set
CONFIG_HZ_100=y
CONFIG_PREEMPT=y
# CONFIG_SECCOMP is not set
CONFIG_MIPS_CMDLINE_FROM_BOOTLOADER=y
CONFIG_CROSS_COMPILE="mips-linux-gnu-"
# CONFIG_LOCALVERSION_AUTO is not set
# CONFIG_SWAP is not set
CONFIG_SYSVIPC=y
CONFIG_POSIX_MQUEUE=y
# CONFIG_CROSS_MEMORY_ATTACH is not set
CONFIG_FHANDLE=y
CONFIG_NO_HZ_IDLE=y
CONFIG_HIGH_RES_TIMERS=y
CONFIG_LOG_BUF_SHIFT=14
CONFIG_CC_OPTIMIZE_FOR_SIZE=y
CONFIG_EXPERT=y
CONFIG_SYSCTL_SYSCALL=y
CONFIG_KALLSYMS_ALL=y
# CONFIG_ADVISE_SYSCALLS is not set
# CONFIG_VM_EVENT_COUNTERS is not set
# CONFIG_SLUB_DEBUG is not set
# CONFIG_COMPAT_BRK is not set
CONFIG_MODULES=y
# CONFIG_LBDAF is not set
# CONFIG_BLK_DEV_BSG is not set
CONFIG_PARTITION_ADVANCED=y
# CONFIG_COREDUMP is not set
CONFIG_NET=y
CONFIG_PACKET=y
CONFIG_UNIX=y
CONFIG_INET=y
CONFIG_IP_MULTICAST=y
CONFIG_IP_PNP=y
CONFIG_IP_PNP_DHCP=y
CONFIG_IP_PNP_BOOTP=y
CONFIG_IP_PNP_RARP=y
# CONFIG_INET_XFRM_MODE_TRANSPORT is not set
# CONFIG_INET_XFRM_MODE_TUNNEL is not set
# CONFIG_INET_XFRM_MODE_BEET is not set
# CONFIG_INET_LRO is not set
# CONFIG_IPV6 is not set
CONFIG_NETWORK_PHY_TIMESTAMPING=y
CONFIG_NETFILTER=y
CONFIG_NETFILTER_XT_TARGET_NFLOG=y
CONFIG_NETFILTER_XT_TARGET_NFQUEUE=y
CONFIG_NETFILTER_XT_MATCH_QUOTA=y
CONFIG_IP_SET=y
CONFIG_IP_SET_BITMAP_IPMAC=y
CONFIG_IP_NF_IPTABLES=y
CONFIG_IP_NF_FILTER=y
CONFIG_IP_NF_MANGLE=y
CONFIG_IP_NF_RAW=y
CONFIG_BT=y
CONFIG_BT_RFCOMM=y
CONFIG_BT_RFCOMM_TTY=y
CONFIG_BT_HCIUART=y
CONFIG_BT_HCIUART_H4=y
CONFIG_BT_HCIUART_LL=y
CONFIG_CFG80211=y
CONFIG_NL80211_TESTMODE=y
CONFIG_CFG80211_WEXT=y
CONFIG_MAC80211=y
CONFIG_MAC80211_MESH=y
CONFIG_RFKILL=y
CONFIG_RFKILL_INPUT=y
CONFIG_UEVENT_HELPER_PATH="/sbin/hotplug"
CONFIG_DEVTMPFS=y
# CONFIG_STANDALONE is not set
# CONFIG_PREVENT_FIRMWARE_BUILD is not set
# CONFIG_FW_LOADER is not set
# CONFIG_ALLOW_DEV_COREDUMP is not set
CONFIG_MTD=y
CONFIG_MTD_CMDLINE_PARTS=y
CONFIG_MTD_BLOCK=y
CONFIG_INGENIC_SFC=y
CONFIG_BCM_43438_RFKILL=y
CONFIG_NETDEVICES=y
CONFIG_INGENIC_MAC=y
CONFIG_INGENIC_MAC_MODE=y
CONFIG_INGENIC_MAC_RMII=y
CONFIG_INGENIC_GPIO_PHY_RESET=y
# CONFIG_NET_VENDOR_ARC is not set
# CONFIG_NET_CADENCE is not set
# CONFIG_NET_VENDOR_BROADCOM is not set
# CONFIG_NET_VENDOR_EZCHIP is not set
# CONFIG_NET_VENDOR_INTEL is not set
# CONFIG_NET_VENDOR_MARVELL is not set
# CONFIG_NET_VENDOR_MICREL is not set
# CONFIG_NET_VENDOR_NATSEMI is not set
# CONFIG_NET_VENDOR_QUALCOMM is not set
# CONFIG_NET_VENDOR_RENESAS is not set
# CONFIG_NET_VENDOR_ROCKER is not set
# CONFIG_NET_VENDOR_SAMSUNG is not set
# CONFIG_NET_VENDOR_SEEQ is not set
# CONFIG_NET_VENDOR_SMSC is not set
# CONFIG_NET_VENDOR_STMICRO is not set
# CONFIG_NET_VENDOR_SYNOPSYS is not set
# CONFIG_NET_VENDOR_VIA is not set
# CONFIG_NET_VENDOR_WIZNET is not set
# CONFIG_USB_NET_DRIVERS is not set
# CONFIG_RTL_CARDS is not set
CONFIG_BCMDHD_1_363_59_144=y
# CONFIG_INPUT_MOUSEDEV is not set
CONFIG_INPUT_EVDEV=y
# CONFIG_KEYBOARD_ATKBD is not set
CONFIG_KEYBOARD_GPIO=y
# CONFIG_INPUT_MOUSE is not set
# CONFIG_SERIO is not set
CONFIG_DEVPTS_MULTIPLE_INSTANCES=y
# CONFIG_LEGACY_PTYS is not set
# CONFIG_DEVKMEM is not set
CONFIG_SERIAL_INGENIC_UART=y
CONFIG_SERIAL_INGENIC_CONSOLE=y
# CONFIG_HW_RANDOM is not set
CONFIG_I2C=y
CONFIG_I2C_MUX=y
CONFIG_I2C_INGENIC=y
CONFIG_GPIO_SYSFS=y
# CONFIG_HWMON is not set
CONFIG_WATCHDOG=y
CONFIG_INGENIC_WDT=y
CONFIG_MFD_INGENIC_TCU=y
CONFIG_MEDIA_SUPPORT=y
CONFIG_MEDIA_CAMERA_SUPPORT=y
CONFIG_V4L_PLATFORM_DRIVERS=y
CONFIG_SOC_CAMERA=y
CONFIG_VIDEO_INGENIC=y
CONFIG_VIDEO_INGENIC_X1000=y
# CONFIG_MEDIA_SUBDRV_AUTOSELECT is not set
CONFIG_SOC_CAMERA_GC2155=y
# CONFIG_DVB_AU8522_V4L is not set
# CONFIG_DVB_TUNER_DIB0070 is not set
# CONFIG_DVB_TUNER_DIB0090 is not set
CONFIG_FB=y
CONFIG_FB_MODE_HELPERS=y
CONFIG_FB_INGENIC=y
CONFIG_FB_INGENIC_NR_FRAMES=1
CONFIG_SLCDC_CONTINUA=y
CONFIG_FB_INGENIC_X1000=y
CONFIG_PANEL_X1000_TRULY_TFT240240_2_E=y
# CONFIG_BACKLIGHT_GENERIC is not set
CONFIG_BACKLIGHT_PWM=y
# CONFIG_VGA_CONSOLE is not set
CONFIG_SOUND=y
CONFIG_SND=y
# CONFIG_SND_PCM_TIMER is not set
# CONFIG_SND_SUPPORT_OLD_API is not set
# CONFIG_SND_PROC_FS is not set
# CONFIG_SND_DRIVERS is not set
# CONFIG_SND_MIPS is not set
# CONFIG_SND_USB is not set
CONFIG_SND_SOC=y
CONFIG_SND_ASOC_INGENIC=y
# CONFIG_HID is not set
# CONFIG_USB_HID is not set
CONFIG_USB=y
CONFIG_USB_ANNOUNCE_NEW_DEVICES=y
CONFIG_USB_MON=y
CONFIG_USB_DWC2=y
CONFIG_INGENIC_USBPHY=y
CONFIG_USB_GADGET=y
CONFIG_USB_CONFIGFS=y
CONFIG_USB_CONFIGFS_ACM=y
CONFIG_USB_CONFIGFS_MASS_STORAGE=y
CONFIG_USB_CONFIGFS_F_FS=y
CONFIG_MMC=y
CONFIG_INGENIC_MMC=y
CONFIG_INGENIC_MMC_MMC0=y
CONFIG_INGENIC_MMC_MMC1=y
CONFIG_RTC_CLASS=y
CONFIG_RTC_DRV_INGENIC=y
# CONFIG_MIPS_PLATFORM_DEVICES is not set
# CONFIG_IOMMU_SUPPORT is not set
CONFIG_PWM=y
CONFIG_PWM_INGENIC=y
CONFIG_GENERIC_PHY=y
# CONFIG_DNOTIFY is not set
# CONFIG_INOTIFY_USER is not set
CONFIG_PROC_KCORE=y
# CONFIG_PROC_PAGE_MONITOR is not set
CONFIG_TMPFS=y
CONFIG_JFFS2_FS=y
CONFIG_JFFS2_FS_WBUF_VERIFY=y
CONFIG_JFFS2_FS_XATTR=y
CONFIG_JFFS2_COMPRESSION_OPTIONS=y
# CONFIG_NETWORK_FILESYSTEMS is not set
CONFIG_NLS_ASCII=y
CONFIG_PRINTK_TIME=y
# CONFIG_ENABLE_WARN_DEPRECATED is not set
# CONFIG_ENABLE_MUST_CHECK is not set
# CONFIG_SECTION_MISMATCH_WARN_ONLY is not set
CONFIG_PANIC_TIMEOUT=10
# CONFIG_SCHED_DEBUG is not set
# CONFIG_DEBUG_PREEMPT is not set
# CONFIG_FTRACE is not set
# CONFIG_CRYPTO_MANAGER_DISABLE_TESTS is not set
# CONFIG_CRYPTO_ECHAINIV is not set
CONFIG_CRYPTO_DEFLATE=y
CONFIG_CRYPTO_LZO=y
# CONFIG_CRYPTO_HW is not set
```
